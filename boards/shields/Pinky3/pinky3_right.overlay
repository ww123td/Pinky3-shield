#include "pinky3.dtsi"

&default_transform { // The matrix transform for this board is 6 columns over because the left half is 6 columns wide according to the matrix.
    col-offset = <7>;
};

&kscan0 {
    col-gpios // cols = {"B2", "B3", "B1", "F7", "F6", "F5", "F4" }
        = <&pro_micro 16 GPIO_ACTIVE_HIGH> // col1 in the schematic
        , <&pro_micro 14 GPIO_ACTIVE_HIGH> // col2 in the schematic
        , <&pro_micro 15 GPIO_ACTIVE_HIGH> // col3 in the schematic
        , <&pro_micro 18 GPIO_ACTIVE_HIGH> // col4 in the schematic
        , <&pro_micro 19 GPIO_ACTIVE_HIGH> // col5 in the schematic
        , <&pro_micro 20 GPIO_ACTIVE_HIGH> // col6 in the schematic
        , <&pro_micro 21 GPIO_ACTIVE_HIGH> // col7 in the schematic
        ;
};

