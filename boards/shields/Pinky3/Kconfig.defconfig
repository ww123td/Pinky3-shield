## boards/shields/Pinky3/Kconfig.defconfig
```kconfig
if pinky3_shield_dongle
	config ZMK_KEYBOARD_NAME
		default "Pinky3 Wireless Dongle"
	
	config ZMK_SPLIT_BLE_ROLE_CENTRAL
		default y
	
	config ZMK_USB
		default y

endif

if pinky3_shield_left || pinky3_shield_right || pinky3_shield_dongle
	config ZMK_SPLIT
		default y
	config ZMK_BLE
		default y
endif
```

## boards/shields/Pinky3/Kconfig.shield
```kconfig
config pinky3_shield_left
    def_bool $(shields_list_contains,pinky3_left)

config pinky3_shield_right
	def_bool $(shields_list_contains,pinky3_right)

config pinky3_shield_dongle
	def_bool $(shields_list_contains,pinky3_dongle)
```
