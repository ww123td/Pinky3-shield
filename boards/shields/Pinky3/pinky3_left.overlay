#include "pinky3.dtsi" // Notice that the main dtsi files are included in the overlay.

&kscan0 {
    col-gpios // col = {"F4", "F5", "F6", "F7", "B1", "B2", "B3" }
        = <&pro_micro 21 GPIO_ACTIVE_HIGH> // col1 in the schematic
        , <&pro_micro 20 GPIO_ACTIVE_HIGH> // col2 in the schematic
        , <&pro_micro 19 GPIO_ACTIVE_HIGH> // col3 in the schematic
        , <&pro_micro 18 GPIO_ACTIVE_HIGH> // col4 in the schematic
        , <&pro_micro 15 GPIO_ACTIVE_HIGH> // col5 in the schematic
        , <&pro_micro 14 GPIO_ACTIVE_HIGH> // col6 in the schematic
        , <&pro_micro 16 GPIO_ACTIVE_HIGH> // col7 in the schematic
        ;
};
